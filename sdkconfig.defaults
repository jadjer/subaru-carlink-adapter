## sdkconfig.defaults
```kconfig
# CONFIG_COMPILER_OPTIMIZATION_PERF=y
# CONFIG_FREERTOS_HZ=1000
CONFIG_TINYUSB_CDC_ENABLED=y
CONFIG_ESP_INT_WDT=n
CONFIG_ESP_TASK_WDT_EN=n
CONFIG_ESP_DEFAULT_CPU_FREQ_MHZ_240=y
CONFIG_ESPTOOLPY_FLASHSIZE_8MB=y
```
